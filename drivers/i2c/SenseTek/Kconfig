## drivers/i2c/SenseTek/Kconfig
```kconfig
#
# SenseTek I2C sensors drivers configuration
#
# Copyright (C) SenseTek/Sitronix 2010
# Patrick Chang patrick_chang@sitronix.com.tw

config SENSETEK_I2C_SENSORS
	bool "SenseTek I2C Sensors"
	depends on I2C
	help
	  Say Y here, and a list of miscellaneous sensor drivers will be displayed.
	  Everything that didn't fit into the other categories is here. This option
	  doesn't affect the kernel.

	  If unsure, say Y.

if SENSETEK_I2C_SENSORS

config STK_ALS22x7
	tristate "STK2207/2217"
	---help---
	Support for STK2207 and STK2217

config STK_ALS_CHANGE_THRESHOLD
	int "ALS Change Threshold (Lux)"
	depends on (STK_ALS22x7)
	default "20"
	---help---
	  To determine the data will be returned or not. (in read() )
	  If difference >= Change Threshold ==>  the data will be returned
	  If difference <  Change Threshold ==>  retrun 0 bytes

config STK_ALS_SAMPLING_RATE
	int "ALS Sampling rate for internal data polling (HZ)"
	depends on (STK_ALS22x7)
	default "10"
	---help---
	  Depending on your r_set and IT.
	  If unsured, please use the default value (10).

config STK_ALS_TRANSMITTANCE
	int "CM3263 Transmittance (1/10,000)"
	depends on (STK_ALS22x7)
	default "169"
	---help---
	Usually, this setting will be 1/4 of STK 2207 

config STK_SHOW_INFO
    bool "Enable Show Info"
    default y
    ---help---
    For debug

endif # SENSETEK_I2C_SENSORS
```
